## app/dts/bindings/behaviors/zmk,behavior-joystick_with_mode.yaml
```yaml
# Copyright (c) 2022 The ZMK Contributors
# SPDX-License-Identifier: MIT

description: Sensor joystick behavior

compatible: "ergocai,behavior_joystick_with_mode"


properties:
  label:
    type: string
    required: true
  "#sensor-binding-cells":
    type: int
    required: true
    const: 1
  # bindings:
    # type: phandles
    # required: true

sensor-binding-cells:
  - param1
```

## app/dts/bindings/behaviors/zmk,behavior-mouse-move.yaml
```yaml
# Copyright (c) 2020 The ZMK Contributors
# SPDX-License-Identifier: MIT

description: Mouse move

compatible: "zmk,behavior-mouse-move"

include: one_param.yaml

properties:
  move_delta:
    type: int
  max_speed:
    type: int
  time_to_max:
    type: int
```

## app/dts/bindings/behaviors/zmk,behavior-mouse-scroll.yaml
```yaml
# Copyright (c) 2020 The ZMK Contributors
# SPDX-License-Identifier: MIT

description: Mouse scroll

compatible: "zmk,behavior-mouse-scroll"

include: one_param.yaml

properties:
  move_delta:
    type: int
  max_speed:
    type: int
  time_to_max:
    type: int
```

## app/module/dts/bindings/sensor/ergocai,joystick.yaml
```yaml
description: |
  Sensor driver for analog joysticks
compatible: "ergocai,joystick"

properties:
  label:
    type: string
    required: true
  adc_x_channel:
    type: int
    required: true
    description: Analog pins for decoder
  adc_y_channel:
    type: int
    required: true
    description: Analog pins for decoder
  adc_channel_reference:
    type: string
    required: false
    description: Analog pins for decoder
  adc_channel_gain:
    type: string
    required: false
    description: Analog pins for decoder
  polling_rate_hertz:
    type: int
    required: false
    description: The frequenty in HZ
  move_step:
    type: int
    required: false
    description: mouse move step
  deadzone:
    type: string 
    required: false
    description: If the sensor is above this, then it is treated as on
```

## app/src/joystick/Kconfig
```kconfig
# Copyright (c) 2020 The ZMK Contributors
# SPDX-License-Identifier: MIT

menuconfig JOYSTICK
	bool "JOYSTICK Analogue Sensor"
    default n
    select ZMK_MOUSE
    select NRFX_RTC2
    select NRFX_SAADC
    select NRFX_PPI
	help
	  Enable driver for Joystick analogue sensors.
```
