/ {
	behaviors {
		/omit-if-no-ref/ mmv: behavior_mouse_move {
			compatible = "zmk,behavior-mouse-move";
			label = "MOUSE_MOVE";
			#binding-cells = <1>;
			move_delta  = <5>;
			max_speed  = <10>;
			time_to_max  = <40>;
		};
	};
};
